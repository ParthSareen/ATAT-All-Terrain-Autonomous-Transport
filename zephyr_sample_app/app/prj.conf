## CMakeLists.txt
```
#-------------------------------------------------------------------------------
# Zephyr Application
#

cmake_minimum_required(VERSION 3.13.1)
find_package(Zephyr REQUIRED HINTS $ENV{ZEPHYR_BASE})

project(app LANGUAGES C VERSION 1.0.0)
target_include_directories(app PRIVATE ${CMAKE_BINARY_DIR}/app/include src include)
target_sources(app PRIVATE 
    src/main.c
)
```

## Kconfig
```
# This file is the application Kconfig entry point. All application Kconfig
# options can be defined here or included via other application Kconfig files.
# You can browse these options using the west targets menuconfig (terminal) or
# guiconfig (GUI).

menu "Zephyr"
source "Kconfig.zephyr"
endmenu

module = APP
module-str = APP
source "subsys/logging/Kconfig.template.log_config"
```

## prj.conf
```kconfig
# This file contains selected Kconfig options for the application.

# compiler
CONFIG_DEBUG_OPTIMIZATIONS=y

# console
CONFIG_CONSOLE=y

# UART console
CONFIG_SERIAL=y
CONFIG_UART_CONSOLE=y

# logging
CONFIG_LOG=y
# CONFIG_APP_LOG_LEVEL_DBG=y

# segger RTT console
CONFIG_USE_SEGGER_RTT=y
CONFIG_RTT_CONSOLE=y
```

## boards/custom_board.overlay
```dts
/*
 * Copyright (c) 2021 Nordic Semiconductor ASA
 * SPDX-License-Identifier: Apache-2.0
 */

/* This devicetree overlay file will be automatically picked by the Zephyr
 * build system when building the sample for the nucleo_f302r8 board. It shows
 * how the example-application can be built on sample boards already provided
 * by Zephyr.
 */

/ {
	examplesensor0: examplesensor_0 {
		compatible = "zephyr,examplesensor";
		label = "EXAMPLESENSOR_0";
		input-gpios = <&gpio_example 13 (GPIO_PULL_UP | GPIO_ACTIVE_LOW)>;
	};
};

&gpio_example {
	status = "okay";
};
```

## src/main.c
```c
#include <zephyr.h>
#include <device.h>
#include <devicetree.h>
#include <drivers/gpio.h>
#include <logging/log.h>

/* 1000 msec = 1 sec */
#define SLEEP_TIME_MS   1000

/* The devicetree node identifier for the "led0" alias. */
#define LED0_NODE DT_ALIAS(led0)

#if DT_NODE_HAS_STATUS(LED0_NODE, okay)

	#define LED0	DT_GPIO_LABEL(LED0_NODE, gpios)
	#define PIN	DT_GPIO_PIN(LED0_NODE, gpios)
	#define FLAGS	DT_GPIO_FLAGS(LED0_NODE, gpios)
	#else
	/* A build error here means your board isn't set up to blink an LED. */
	#error "Unsupported board: led0 devicetree alias is not defined"
	#define LED0	""
	#define PIN	0
	#define FLAGS	0

#endif

LOG_MODULE_REGISTER(main);

void main(void)
{
	const struct device *dev;
	bool led_is_on = true;
	int ret;

	dev = device_get_binding(LED0);
	if (dev == NULL) {
		LOG_INF("Devicetree is NULL");
		LOG_DBG("Devicetree is NULL");
		return;
	}

	ret = gpio_pin_configure(dev, PIN, GPIO_OUTPUT_ACTIVE | FLAGS);
	if (ret < 0) {
		return;
	}

	while (1) {

		LOG_INF("Running Main() \n");
		k_sleep(K_MSEC(1000));

		gpio_pin_set(dev, PIN, (int)led_is_on);
		led_is_on = !led_is_on;
		k_msleep(SLEEP_TIME_MS);
	}
}
```
