## zephyr_apps/west.yml
```yaml
# Main manifest for the entire directory

manifest:
  self:
    path: zephyr_apps

  remotes:
    - name: zephyrproject-rtos
      url-base: https://github.com/zephyrproject-rtos

  projects:
    - name: zephyr
      remote: zephyrproject-rtos
      revision: main
      import: true
```

## zephyr_sample_app/west.yml
```yaml
# Main manifest for the entire directory

manifest:
  self:
    path: zephyr_sample_app

  remotes:
    - name: zephyrproject-rtos
      url-base: https://github.com/zephyrproject-rtos

  projects:
    - name: zephyr
      remote: zephyrproject-rtos
      revision: main
      import: true
```
